## Libraries/SpIOpen_Broker/Kconfig
```kconfig
menu SpIOpen Protocol Features

config SPIOPEN_BROKER_FRAME_POOL_SIZE_CONFIGURABLE
    bool "Support configurable (non-static) spiopen frame pools"
    default n
    help
        This allows a setting on the device to determine the size of the SpIOpen frame broker pool, but requires heap allocation of the frame pool at initialization.

config SPIOPEN_BROKER_MAX_SUBSCRIBER_COUNT
    int "Maximum number of simultaneous subscribers supported by the frame broker"
    range 4 128
    default 8
    help
        This options accepts integer values from 4 to 255. Each app and port is a subscriber

config SPIOPEN_BROKER_FRAME_POOL_MAX_CC_FRAMES
    int "Maximum number of CAN-CC Frames that can be configured in the CC Frame Pool"
    range 0 255
    default 32
    help
        The maximum (or fixed when non-configurable) number of CAN-CC frames available in the Frame Pool

config SPIOPEN_BROKER_FRAME_POOL_MAX_FD_FRAMES
    int "Maximum number of CAN-FD Frames that can be configured in the FD Frame Pool"
    range 0 255
    default 32
    help
        The maximum (or fixed when non-configurable) number of CAN-FD frames available in the Frame Pool

config SPIOPEN_BROKER_FRAME_POOL_MAX_XL_FRAMES
    int "Maximum number of CAN-XL Frames that can be configured in the XL Frame Pool"
    range 0 255
    default 32
    help
        The maximum (or fixed when non-configurable) number of CAN-XL frames available in the Frame Pool

config SPIOPEN_BROKER_MAILBOX_DEPTH_CONFIGURABLE
    bool "Support configurable (heap-backed) broker mailbox depth"
    default n
    help
        If enabled, mailbox queue storage and depth may be provided at runtime
        (typically from heap-backed initialization). If disabled, mailbox depth
        is fixed at compile time from SPIOPEN_BROKER_MAILBOX_MAX_DEPTH.

config SPIOPEN_BROKER_MAILBOX_MAX_DEPTH
    int "Maximum mailbox depth for broker mailbox queues"
    range 1 255
    default 32
    help
        The maximum (or fixed when non-configurable) queue depth for each broker
        mailbox. This setting applies to broker inbox and subscriber mailboxes.
```

## Libraries/SpIOpen_Frame/Kconfig
```kconfig
menu "SpIOpen Frame Library"

    config SPIOPEN_FRAME_CAN_XL_ENABLE
        bool "Support CAN-XL Frames"
        default y
        help
            This enables support for CAN-XL frames, which increases the max payload size to 2048 bytes. This is required to tunnel CAN-FD frames and useful to tunnel ethernet frames. It can have negative effects on performance.

endmenu
```

## Libraries/SpIOpen_Lifecycle/Kconfig
```kconfig
menu "SpIOpen Lifecycle Library"

config SPIOPEN_LIFECYCLE_ENABLE_AGGREGATE_COMPONENTS
    bool "Enable aggregate lifecycle component interfaces"
    default y
    help
        Enables IAggregateLifecycleComponent and related compile-time helpers
        for composing lifecycle components from child components.

endmenu
```

## Libraries/SpIOpen_Message/Kconfig
```kconfig
menu "SpIOpen Message Features"

config SPIOPEN_MESSAGE_ALLOW_HEAP_ALLOCATION_AT_INIT
    bool "Allow heap allocation during component initialization"
    default n
    help
        If enabled, lifecycle components that require backing memory (frame pools,
        mailbox queues, broker thread stack) may allocate missing storage during
        Initialize(). If disabled, all required backing memory must be provided
        through component configuration before initialization.

config SPIOPEN_MESSAGE_MAX_SUBSCRIBER_COUNT
    int "Maximum number of simultaneous subscribers supported by the frame broker"
    range 4 128
    default 8
    help
        This options accepts integer values from 4 to 255. Each app and port is a subscriber

config SPIOPEN_MESSAGE_FRAME_POOL_MAX_CC_FRAMES
    int "Maximum number of CAN-CC Frames that can be configured in the CC Frame Pool"
    range 0 255
    default 32
    help
        The maximum number of CAN-CC frames allowed in the Frame Pool.

config SPIOPEN_MESSAGE_FRAME_POOL_MAX_FD_FRAMES
    int "Maximum number of CAN-FD Frames that can be configured in the FD Frame Pool"
    range 0 255
    default 32
    help
        The maximum number of CAN-FD frames allowed in the Frame Pool.

config SPIOPEN_MESSAGE_FRAME_POOL_MAX_XL_FRAMES
    int "Maximum number of CAN-XL Frames that can be configured in the XL Frame Pool"
    range 0 255
    default 32
    help
        The maximum number of CAN-XL frames allowed in the Frame Pool.

config SPIOPEN_MESSAGE_MAILBOX_MAX_DEPTH
    int "Maximum mailbox depth for broker mailbox queues"
    range 1 255
    default 32
    help
        The maximum queue depth for each broker mailbox.
        This setting applies to broker inbox and subscriber mailboxes.

config SPIOPEN_MESSAGE_THREAD_MAX_STACK_SIZE
    int "Maximum broker thread stack size in bytes"
    range 128 65535
    default 2048
    help
        The maximum stack size used by the FrameBroker thread.

endmenu
```

## SpIOpen/Kconfig
```kconfig
menu SpIOpen Protocol Features

config SPIOPEN_CONFIGURABLE_FRAME_POOL
    bool "Support configurable (non-static) spiopen frame pool"
    default n
    help
        This allows a setting on the device to determine the size of the spiopen frame router pool, but requires heap allocation of the frame pool at initialization.
```
